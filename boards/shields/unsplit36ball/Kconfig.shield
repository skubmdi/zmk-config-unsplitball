## boards/shields/unsplitball/Kconfig.defconfig
```kconfig
if SHIELD_UNSPLITBALL

config ZMK_KEYBOARD_NAME
    default "unsplitball"

endif
```

## boards/shields/unsplitball36/Kconfig.defconfig
```kconfig
if SHIELD_UNSPLITBALL36

config ZMK_KEYBOARD_NAME
    default "unsplitball36"

endif
```

## config/boards/shields/unsplit36ball/Kconfig.defconfig
```kconfig
if SHIELD_UNSPLIT36BALL

config ZMK_KEYBOARD_NAME
    default "unsplit36ball"

endif
```
